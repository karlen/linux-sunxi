## Documentation/devicetree/bindings/input/touchscreen/silead_gsl1680.txt
```
* GSL 1680 touchscreen controller

Required properties:
- compatible		  : "silead,gsl1680"
- reg			  : I2C slave address of the chip (0x40)
- interrupt-parent	  : a phandle pointing to the interrupt controller
			    serving the interrupt for this chip
- interrupts		  : interrupt specification for the gsl1680 interrupt
- wake-gpios		  : GPIO specification for the WAKE input
- touchscreen-size-x	  : horizontal resolution of touchscreen (in pixels)
- touchscreen-size-y	  : vertical resolution of touchscreen (in pixels)
- touchscreen-max-fingers : maximal input values given to inputsystem

Optional properties:
- touchscreen-inverted-x  : X axis is inverted (boolean)
- touchscreen-inverted-y  : Y axis is inverted (boolean)
- touchscreen-swapped-x-y : X and Y axis are swapped (boolean)
			    Swapping is done after inverting the axis

Example:

i2c@00000000 {

	gsl1680: touchscreen@40 {
		compatible = "silead,gsl1680";
		reg = <0x40>;
		interrupt-parent = <&pio>;
		interrupts = <6 11 IRQ_TYPE_EDGE_FALLING>;
		power-gpios = <&pio 1 3 GPIO_ACTIVE_HIGH>;
		touchscreen-size-x = <480>;
		touchscreen-size-y = <800>;
		touchscreen-max-fingers = <5>;
		touchscreen-inverted-x;
		touchscreen-swapped-x-y;
	};

	/* ... */
};
```

## Documentation/devicetree/bindings/sound/sunxi,spdif.txt
```
Allwinner Sony/Philips Digital Interface Format (S/PDIF) Controller

The Allwinner S/PDIF audio block is a transceiver that allows the
processor to receive and transmit digital audio via an coaxial cable or
a fibre cable.

Required properties:

  - compatible		: should be one of the following:
    - "allwinner,sun4i-a10-spdif": for the Allwinner A10 SoC
    - "allwinner,sun7i-a20-spdif": for the Allwinner A20 SoC
    - "allwinner,sun6i-a31-spdif": for the Allwinner A31 SoC

  - reg			: Offset and length of the register set for the device.

  - interrupts		: Contains the spdif interrupt.

  - dmas		: Generic dma devicetree binding as described in
			  Documentation/devicetree/bindings/dma/dma.txt.

  - dma-names		: Two dmas have to be defined, "tx" and "rx".

  - clocks		: Contains an entry for each entry in clock-names.

  - clock-names		: Includes the following entries:
	"apb"		  clock for the spdif bus.
	"audio"		  clock from the audio pll.
	"spdif"		  clock for spdif controller.

Optional:

  - spdif-in		: Enable block for capturing an SPDIF signal.

  - spdif-out		: Enable block for transmitting an SPDIF signal.

Example:

spdif: spdif@01c21000 {
	compatible = "allwinner,sun4i-a10-spdif";
	reg = <0x01c21000 0x40>;
	interrupts = <13>;
	clocks = <&apb0_gates 1>, <&pll2 0>, <&spdif_clk>;
	clock-names = "apb", "audio", "spdif";
	dmas = <&dma 0 2>, <&dma 0 2>;
	dma-names = "rx", "tx";
	spdif-in = "disabled";
	spdif-out = "okay";
	status = "okay";
};
```

## drivers/gpu/ion/Kconfig
```kconfig
menuconfig ION
	tristate "Ion Memory Manager"
	select GENERIC_ALLOCATOR
	select DMA_SHARED_BUFFER
	help
	  Chose this option to enable the ION Memory Manager.

config ION_TEGRA
	tristate "Ion for Tegra"
	depends on ARCH_TEGRA && ION
	help
	  Choose this option if you wish to use ion on an nVidia Tegra.

config ION_SUNXI_CARVEOUT_SIZE
	int "memory size(in MB) for sunxi carveout ion heap."
	default 360
	depends on ION
	help
	  Select memory size for sunxi carveout ion heap, the memory is used by gpu.
	  Examples:
	  	     100 => reserve 100M bytes memory for carveout heap.
	  	     230 => reserve 230M bytes memory for carveout heap.
```

## sound/soc/allwinner/Kconfig
```kconfig
config SND_SOC_SUN6I_AUDIO_CODEC
	depends on ARCH_SUNXI
	select MFD_CORE
	select REGMAP_MMIO
	select SND_SOC_GENERIC_DMAENGINE_PCM
	tristate "Allwinner A31 Audio Codec Support"
```

## sound/soc/sunxi/Kconfig
```kconfig
menu "Allwinner SoC Audio support"

config SND_SUN4I_CODEC
	tristate "Allwinner A10 Codec Support"
	select SND_SOC_GENERIC_DMAENGINE_PCM
	select REGMAP_MMIO
	help
	  Select Y or M to add support for the Codec embedded in the Allwinner
	  A10 and affiliated SoCs.

config SND_SUN4I_I2S
	tristate "APB on-chip sun4i/sun5i/sun7i I2S"
	select SND_SOC_GENERIC_DMAENGINE_PCM
	select REGMAP_MMIO
	default m

config SND_SUNXI_UDA1380
	tristate "Audio support for A20 with UDA1380 codec on I2S DA0"
	depends on SND_SUN4I_I2S && I2C
	select SND_SIMPLE_CARD
	select SND_SOC_UDA1380
	help
	  Say Y if you want to add support for ASoC audio on an A20 board
	  with a UDA1380 codec on I2S DA0 interface.

config SND_SUN4I_SPDIF
        tristate "Allwinner A10 SPDIF Support"
	depends on OF
        select SND_SOC_GENERIC_DMAENGINE_PCM
        select REGMAP_MMIO
        help
          Say Y or M to add support for the S/PDIF audio block in the Allwinner
	  A10 and affiliated SoCs.

config SND_SUN6I_AUDIO_CODEC
	depends on ARCH_SUN6I
	select MFD_CORE
	select REGMAP_MMIO
	select SND_SOC_GENERIC_DMAENGINE_PCM
	tristate "Allwinner A31 Audio Codec Support"

endmenu
```
